## thirdparty/lambdasoc/software/bios/src/Kconfig
```kconfig
mainmenu "LambdaSoC BIOS Configuration"

source src/arch/Kconfig

source src/drivers/Kconfig

menu "Memory configuration"

config ROM_START
	hex "ROM start address"

config ROM_SIZE
	hex "ROM size"

config RAM_START
	hex "RAM start address"

config RAM_SIZE
	hex "RAM size"

config UART_START
	hex "UART start address"

config TIMER_START
	hex "Timer start address"

if WITH_SDRAM

config SDRAM_START
	hex "SDRAM start address"

config SDRAM_SIZE
	hex "SDRAM size"

endif # WITH_SDRAM

endmenu

menu "Interrupt configuration"

config UART_IRQNO
	int "UART IRQ number"

config TIMER_IRQNO
	int "Timer IRQ number"

endmenu

config CLOCK_FREQ
	int "System clock frequency (in Hz)"
```

## thirdparty/lambdasoc/software/bios/src/arch/Kconfig
```kconfig
menu "CPU"

choice
	prompt "CPU"
	default CPU_MINERVA

config CPU_MINERVA
	bool "Minerva"
	select ARCH_RISCV

endchoice

config CPU_BYTEORDER
	string
	default "little" if CPU_MINERVA

config CPU_RESET_ADDR
	hex "Reset vector address"

source src/arch/riscv/Kconfig

endmenu
```

## thirdparty/lambdasoc/software/bios/src/arch/riscv/Kconfig
```kconfig
config ARCH_RISCV
	bool

if ARCH_RISCV

config RISCV_TRIPLE
	string #"Toolchain triple" FIXME
	default "riscv64-unknown-elf"

config RISCV_MULDIV_SOFT
	bool "Emulate support for integer multiplication and division"
	default y

endif # if ARCH_RISCV
```

## thirdparty/lambdasoc/software/bios/src/drivers/Kconfig
```kconfig
menu "Drivers"

source src/drivers/uart/Kconfig
source src/drivers/timer/Kconfig
source src/drivers/sdram/Kconfig

endmenu
```

## thirdparty/lambdasoc/software/bios/src/drivers/sdram/Kconfig
```kconfig
menu "SDRAM"

config WITH_SDRAM
	bool "Enable SDRAM support"
	default n

endmenu
```

## thirdparty/lambdasoc/software/bios/src/drivers/timer/Kconfig
```kconfig
menu "Timer"

config TIMER_CTR_WIDTH
	int "Counter width (in bits)"
	range 0 32

endmenu
```

## thirdparty/lambdasoc/software/bios/src/drivers/uart/Kconfig
```kconfig
menu "UART"

config UART_RX_RINGBUF_SIZE_LOG2
	int "UART RX ring buffer size (as log2)"
	default 7
	help
	  Actual RX ring buffer size is 2**CONFIG_RX_RINGBUF_SIZE_LOG2.

config UART_TX_RINGBUF_SIZE_LOG2
	int "UART TX ring buffer size (as log2)"
	default 7
	help
	  Actual TX ring buffer size is 2**CONFIG_TX_RINGBUF_SIZE_LOG2.

endmenu
```
